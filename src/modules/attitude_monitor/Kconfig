## src/modules/attitude_monitor/Kconfig
```kconfig
menuconfig MODULES_ATTITUDE_MONITOR
	bool "attitude_monitor"
	default n
	---help---
		Event-driven work queue module that monitors vehicle attitude (learning project)
```

## src/modules/simulation/baro_noise_sim/Kconfig
```kconfig
menuconfig MODULES_SIMULATION_BARO_NOISE_SIM
	bool "baro_noise_sim"
	default n
	---help---
		Simulated barometer with configurable noise, drift and faults (learning project)
```
